## components/sensor/Kconfig
```kconfig
menu "WellD Sensor"

    config WELLD_SENSOR_ADC_CHANNEL
        int "ADC1 channel for 4-20 mA sensor"
        default 0
        range 0 6

    config WELLD_SENSOR_SHUNT_MILLIOHMS
        int "Shunt resistor value (milliohms)"
        default 100000
        range 1000 155000
        help
            Value in milliohms. 100000 = 100 Ω → 4 mA gives 0.40 V, 20 mA gives 2.00 V.
            Upper bound is 155 Ω (155000 mΩ): at 20 mA full scale that produces 3.1 V,
            the top of the ADC linear range. Higher values exceed the ESP32-C6 ADC
            absolute-maximum input of 3.6 V and will damage the GPIO pin.

    config WELLD_SENSOR_MAX_DEPTH_CM
        int "Maximum well depth (centimeters)"
        default 600
        help
            Depth at 20 mA (full-scale output of the transducer). 600 = 6 m.

    config WELLD_SENSOR_OFFSET_CM
        int "Water level offset (centimeters, signed)"
        default 0
        range -600 600
        help
            Added to the computed level after scaling. Use a negative value
            when the transducer sits below the true zero reference point
            (e.g. -50 if it hangs 50 cm below the water outlet pipe).
            Can be overridden at runtime via NVS key "welld/offset_cm".
            Both this default and any runtime value written to NVS key
            'welld/offset_cm' are clamped to the range -600 to +600 cm at
            runtime.

    config WELLD_BATT_REPORT_ENABLED
        bool "Report battery voltage over Zigbee (EP2)"
        default y
        help
            Registers Zigbee endpoint 2 (Analog Input, battery volts) and
            reports the battery voltage to the coordinator on every wakeup.
            The battery is always measured internally via the ADS1115 AIN2
            gated resistor divider for the low-battery guard, regardless of
            this option — disabling it only removes the Zigbee endpoint.

    config WELLD_BATT_DIVIDER_RATIO
        int "Battery divider ratio * 100 (e.g. 200 = 2:1 divider)"
        default 200
        range 100 1000
        help
            PCB R7/R8 = 100 kΩ / 100 kΩ divider = ratio 200 (1S board, 2026-07-19);
            VBAT range 3.0–4.2 V. Reported voltage = ADC voltage * ratio / 100.
            The AIN2 read uses the ADS1115 ±4.096 V PGA, so the 2.1 V divider
            maximum at full charge fits with margin (±2.048 V would clip).
            Used for the ADS1115 AIN2 battery divider read (the only battery
            measurement path on this hardware).

    config WELLD_BATT_FULL_MV
        int "Battery full voltage (mV)"
        default 4200
        range 3000 12000
        help
            Voltage read at 100 % state of charge. 4200 = 1S2P 18650 (4.2 V).
            Used by the Z2M converter to compute the battery percentage.
            (The low-battery send/NVS-skip guard uses WELLD_BATT_EMPTY_MV,
            not this option.)

    config WELLD_BATT_EMPTY_MV
        int "Battery empty voltage (mV)"
        default 3000
        range 2000 10000
        help
            Voltage read at 0 % state of charge. 3000 = 1S2P 18650 (3.0 V —
            also the ESP32-C6 minimum supply through the HT7333 LDO passthrough).
            When battery voltage (from ADC divider) drops at or below this
            threshold, the device skips the Zigbee send and all NVS writes and
            sleeps for the maximum interval to conserve charge.

    config WELLD_DS18B20_GPIO
        int "GPIO number for DS18B20 data line"
        default 7
        range 0 21
        help
            GPIO connected to the DS18B20 data pin via a 4.7 kΩ pull-up to 3.3 V.
            External power mode is required: connect DS18B20 VCC to 3.3 V and GND
            to GND. Parasite-power mode (VCC pin tied to GND) is not supported —
            the RMT one-wire driver does not drive a strong pull-up during
            conversion, so a parasite-powered sensor will stall and return an
            out-of-range reading that is silently discarded every wakeup.

    config WELLD_I2C_SDA_GPIO
        int "I2C SDA GPIO (ADS1115)"
        range 0 21
        default 10
        help
            GPIO number for the I2C SDA line. Used by ADS1115 (16-bit ADC,
            0x48). MAX17048 removed in an earlier hardware redesign.

    config WELLD_I2C_SCL_GPIO
        int "I2C SCL GPIO (ADS1115)"
        range 0 21
        default 11
        help
            GPIO number for the I2C SCL line.

    config WELLD_VLOOP_GPIO
        int "VLOOP 12 V boost enable GPIO (MT3608B EN)"
        range 0 21
        default 5
        help
            Drive HIGH before any 4-20 mA transducer read; hold HIGH for
            at least 10 ms to guarantee the 12 V rail is stable — the boost
            output caps (C20/C22) charge through the Q3 load-disconnect
            P-FET, so the rail settles slower than the bare MT3608B
            soft-start (< 5 ms typical). Drive LOW immediately after.
            Max ON time 100 ms per wake cycle.

    config WELLD_BATT_DIV_EN_GPIO
        int "Battery divider enable GPIO (Q2 gate)"
        range 0 21
        default 15
        help
            Drives Q2 gate (AO3400A). HIGH enables the R7/R8 resistor divider
            (100 kΩ / 100 kΩ on the 1S board) connected to ADS1115 AIN2 via
            the Q5 high-side P-FET. Drive HIGH for 1 ms
            before reading; LOW after to prevent quiescent divider drain.

    config WELLD_ADS1115_DRDY_GPIO
        int "ADS1115 ALERT/DRDY GPIO"
        range 0 21
        default 12
        help
            GPIO connected to the ADS1115 ALERT/DRDY open-drain output. The
            sensor component configures the ADS1115 in conversion-ready mode
            (Lo_thresh = 0x8000, Hi_thresh = 0x7FFF per datasheet) so the pin
            pulses LOW when each single-shot conversion completes. The GPIO is
            configured as input with the ESP32-C6 internal pull-up enabled
            (ADS1115 ALERT/DRDY is open-drain). A falling-edge ISR releases a
            binary semaphore so the sensor task can block instead of polling.
            Timeout fallback of 10 ms protects against a missing edge.

    config WELLD_SOLAR_DETECT_GPIO
        int "Solar charging detect GPIO (/CHRG, active-low)"
        range 0 21
        default 6
        help
            Input. Active-low: LOW means the CN3791 solar MPPT charger is
            actively charging. HIGH means no solar charging. Reported to the
            Zigbee coordinator as part of the status payload.

    config WELLD_ADC_OVERSAMPLE_ENABLED
        bool "ADC oversampling (median-of-three)"
        default n
        help
            Take 3 ADS1115 samples per channel and report the median.
            Rejects single-sample noise outliers at the cost of ~4 ms extra
            active time per channel (~12 ms total vs ~4 ms). Enable for
            electrically noisy installations; leave off for maximum battery life.

    config WELLD_TEMP_COMPENSATION_ENABLED
        bool "Temperature compensation for water level"
        default y
        help
            Compensate water-level readings for water density change with
            temperature. Requires CONFIG_WELLD_TEMP_COMPENSATION_PPM_PER_C.
            At 207 ppm/°C the correction is <0.21 % per 10 °C deviation from
            20 °C — small but systematic. Disabled automatically when the
            DS18B20 read fails (guard in main.c: temp > -127.0 °C).

    config WELLD_TEMP_COMPENSATION_PPM_PER_C
        int "Water density coefficient (ppm/°C)"
        default 207
        range 0 500
        depends on WELLD_TEMP_COMPENSATION_ENABLED
        help
            Typical value for fresh water is ~207 ppm/°C. The reported level
            is corrected as: level = raw / (1 + coeff*(temp - 20°C)).

    config WELLD_DS18B20_RESOLUTION_BITS
        int "DS18B20 resolution (bits)"
        default 11
        range 9 12
        help
            Conversion time: 9-bit = 94 ms, 10-bit = 188 ms, 11-bit = 375 ms,
            12-bit = 750 ms. Lower resolution saves active time and battery.
            11-bit gives 0.0625 °C steps — adequate for well water monitoring
            and saves 375 ms per wakeup compared to 12-bit.

endmenu
```

## components/zigbee/Kconfig
```kconfig
menu "WellD Zigbee"

    config WELLD_ZIGBEE_CHANNEL_MASK
        hex "Zigbee channel mask"
        default 0x07FFF800
        help
            Bitmask of channels to scan during network steering.
            0x07FFF800 = all 2.4 GHz channels (11-26).
            Single channel examples: ch11=0x00000800, ch15=0x00008000,
            ch20=0x00100000, ch25=0x02000000.

    config WELLD_ZIGBEE_SEND_DELAY_MS
        int "Post-send delay before sleeping (ms)"
        default 2000
        range 500 5000
        help
            Time the Zigbee stack stays alive after sending the report,
            giving the coordinator time to acknowledge. Reduce to save
            battery; increase on slow or congested networks.

endmenu
```

## main/Kconfig.projbuild
```kconfig
menu "WellD Configuration"

    config WELLD_SLEEP_DURATION_SEC
        int "Deep sleep duration (seconds)"
        default 300
        range 30 3600
        help
            Baseline sleep duration between wakeups. When adaptive sleep is
            enabled, this is the "normal-rate-of-change" window; the actual
            sleep duration is scaled up when the level is stable and down
            when it's changing fast. Note: the fast-rate target is
            default/4 (integer division); at the minimum value of 30 s this
            equals 7 s, which the WELLD_SLEEP_MIN_SEC floor immediately
            overrides — very short base values make the fast-rate band
            unreachable.

    config WELLD_ADAPTIVE_SLEEP_ENABLED
        bool "Adaptive sleep duration"
        default y
        help
            Adjust sleep duration based on the level rate-of-change observed
            between the last two wakeups. Stable wells get longer sleeps
            (saving battery); fast-changing wells get shorter sleeps
            (catching transients). Disable to use WELLD_SLEEP_DURATION_SEC
            verbatim.

    config WELLD_SLEEP_MIN_SEC
        int "Adaptive sleep — minimum (seconds)"
        default 60
        range 30 3600
        depends on WELLD_ADAPTIVE_SLEEP_ENABLED
        help
            Lower bound on adaptive sleep. The device will never sleep less
            than this even when the level is changing rapidly.

    config WELLD_SLEEP_MAX_SEC
        int "Adaptive sleep — maximum (seconds)"
        default 1800
        range 60 7200
        depends on WELLD_ADAPTIVE_SLEEP_ENABLED
        help
            Upper bound on adaptive sleep. The device will never sleep
            longer than this, even when the level is perfectly stable.

    config WELLD_DIAGNOSTIC_MODE_ENABLED
        bool "Diagnostic mode (bench test)"
        default n
        help
            When enabled, the device stays awake for DIAGNOSTIC_STAY_AWAKE_SEC
            after each sensor read, printing verbose logs at INFO level.
            Useful for bench testing without recompiling. Deep sleep is still
            entered after the stay-awake window expires.

    config WELLD_DIAGNOSTIC_STAY_AWAKE_SEC
        int "Diagnostic mode — stay-awake duration (seconds)"
        default 60
        range 10 300
        depends on WELLD_DIAGNOSTIC_MODE_ENABLED
        help
            How long to stay awake in diagnostic mode before entering deep sleep.

    config WELLD_ZIGBEE_BACKOFF_MAX_MS
        int "Zigbee steering random backoff max (ms)"
        default 500
        range 0 5000
        help
            Random delay before starting Zigbee network steering on each wakeup.
            Jitters the start time by 0 … N ms to prevent multiple devices from
            steering simultaneously after a power outage ("steer storm").
            Set to 0 to disable.

    config WELLD_OTA_STALL_TIMEOUT_SEC
        int "OTA stall timeout (seconds)"
        default 240
        range 60 600
        help
            Maximum wall-clock time an OTA download may take before it is
            considered stalled and aborted. Prevents a hung download from
            keeping the radio alive indefinitely.

    config WELLD_RTC_LOG_PRINT_ENABLED
        bool "Print RTC event log on every wakeup"
        default n
        help
            On every wakeup, emit the last 16 RTC events (boot, send,
            fail, OTA, etc.) to the serial log.  Useful for field
            diagnosis when the device is retrieved and monitored over USB,
            but adds up to 17 log lines per wakeup in production.
            Disable to keep the active-phase serial output minimal.

    config WELLD_SELFTEST_ENABLED
        bool "Self-test mode (peripheral health check on boot)"
        default n
        help
            On every boot, exercise all peripherals and log PASS/FAIL.
            Adds ~200 ms to boot time. Useful for factory QA and PCB bring-up.

    config WELLD_FACTORY_RESET_GPIO
        int "Factory reset GPIO (hold LOW at boot)"
        range 0 21
        default 13
        help
            If this GPIO is held LOW during boot, NVS is erased and the
            device reboots for a clean Zigbee join. Internal pull-up is
            enabled; leave unconnected for normal operation.

endmenu
```

## sdkconfig.defaults
```kconfig
CONFIG_PARTITION_TABLE_CUSTOM=y
CONFIG_PARTITION_TABLE_CUSTOM_FILENAME="partitions.csv"

# Two 1.5 MB OTA slots require at least 4 MB flash.
CONFIG_ESPTOOLPY_FLASHSIZE_4MB=y

# Zigbee stack — required for esp-zigbee-lib to register correctly in CMake.
# ZED = Zigbee End Device (battery-powered, deep-sleeping well monitor).
CONFIG_ZB_ENABLED=y
CONFIG_ZB_ZED=y
# Enable 1.x backward-compat layer in esp-zigbee-lib 2.0.x so that all
# esp_zb_* APIs that did not change continue to compile and link.
CONFIG_ZB_SDK_1xx=y

# Watchdog — reboot if a task (e.g. Zigbee stack callback) hangs.
CONFIG_ESP_TASK_WDT_EN=y
CONFIG_ESP_TASK_WDT_TIMEOUT_S=30

# Brownout detection — log reset reason when battery sags under TX load.
CONFIG_ESP_BROWNOUT_DET=y

# Secure Boot V2 — ECDSA-P256 app signing.
# The bootloader rejects any image whose signature does not verify against the
# public key digest burned into eFuse. Once eFuses are burned this is permanent.
#
# CI builds are UNSIGNED (private key never leaves your machine).
# Sign and flash locally:
#   1. Build:  idf.py build
#   2. Sign:   espsecure sign-data --version 2 --keyfile secure_boot_signing_key.pem \
#                --output build/welld-signed.bin build/welld.bin
#   3. Flash:  idf.py -p /dev/ttyUSB0 flash   (uses the signed binary automatically
#              when CONFIG_SECURE_BOOT_BUILD_SIGNED_BINARIES=y in local config)
#
# Key management:
#   Generate once:  espsecure generate-signing-key --version 2 --scheme ecdsa256 secure_boot_signing_key.pem
#   secure_boot_signing_key.pem is gitignored — never commit or upload it.
CONFIG_SECURE_BOOT=y
CONFIG_SECURE_SIGNED_APPS_ECDSA_V2_SCHEME=y
# BUILD_SIGNED_BINARIES is intentionally off in shared defaults — CI builds
# unsigned; enable in sdkconfig.defaults.local on the machine that holds the key.
# CONFIG_SECURE_BOOT_BUILD_SIGNED_BINARIES=y
# CONFIG_SECURE_BOOT_SIGNING_KEY="secure_boot_signing_key.pem"

# Secure boot bootloader is ~44 KB; default partition table offset (0x8000)
# is too small. Push to 0x10000 (64 KB) to give the bootloader headroom.
CONFIG_PARTITION_TABLE_OFFSET=0x10000
```
