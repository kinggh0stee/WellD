## sdkconfig.defaults.local.example
```kconfig
# Copy this file to sdkconfig.defaults.local and fill in your values.
# sdkconfig.defaults.local is gitignored — credentials never touch git.

# Sensor — set these to match your hardware
# CONFIG_WELLD_SENSOR_ADC_CHANNEL=0
# CONFIG_WELLD_SENSOR_SHUNT_MILLIOHMS=100000
# CONFIG_WELLD_SENSOR_MAX_DEPTH_CM=600

# Level offset — cm added to the reading after scaling (can be negative).
# E.g. -15 if the transducer sits 15 cm above the well bottom.
# Persisted in NVS; can also be updated at runtime via sensor_set_offset_cm().
# CONFIG_WELLD_SENSOR_OFFSET_CM=0

# Battery reporting — Zigbee EP2 (battery volts), on by default. Set to n to
# drop the endpoint; the battery is still measured internally for the
# low-battery guard either way.
# CONFIG_WELLD_BATT_REPORT_ENABLED=y
# CONFIG_WELLD_BATT_DIVIDER_RATIO=200  # R7/R8 = 100 kΩ / 100 kΩ

# Battery percentage thresholds — these set the defaults shown in the Z2M
# converter. Override per-device in the Zigbee2MQTT device options UI instead
# of changing these, since they are not read by the firmware at runtime.
# CONFIG_WELLD_BATT_FULL_MV=4200   # 1S2P 18650 full charge
# CONFIG_WELLD_BATT_EMPTY_MV=3000  # 1S2P 18650 minimum safe discharge

# DS18B20 temperature sensor GPIO
# CONFIG_WELLD_DS18B20_GPIO=4

# Sleep interval
# CONFIG_WELLD_SLEEP_DURATION_SEC=300

# Zigbee — narrow the channel mask to your coordinator's channel
# to speed up joining. ch11=0x800 ch15=0x8000 ch20=0x100000 ch25=0x2000000
# CONFIG_WELLD_ZIGBEE_CHANNEL_MASK=0x07FFF800
# CONFIG_WELLD_ZIGBEE_SEND_DELAY_MS=2000

# ---------- Hardware I/O (custom PCB) ----------
# I2C bus — ADS1115 only
# CONFIG_WELLD_I2C_SDA_GPIO=18   # GPIO10/11 not bonded on ESP32-C6-MINI-1
# CONFIG_WELLD_I2C_SCL_GPIO=19

# 12 V VLOOP boost enable — MT3608B EN, gated by firmware before transducer read
# CONFIG_WELLD_VLOOP_GPIO=5

# Solar charging detect — /CHRG, active-low (CN3791 on 1S boards)
# CONFIG_WELLD_SOLAR_DETECT_GPIO=6

# Battery resistor-divider enable — Q2 gate, pulsed before AIN2 read
# CONFIG_WELLD_BATT_DIV_EN_GPIO=15

# ---------- Secure boot (local signing machine only) ----------
# Uncomment on the machine that holds secure_boot_signing_key.pem.
# Do NOT enable in CI — the private key must never leave your machine.
# CONFIG_SECURE_BOOT_BUILD_SIGNED_BINARIES=y
# CONFIG_SECURE_BOOT_SIGNING_KEY="secure_boot_signing_key.pem"

# ---------- Adaptive sleep ----------
# CONFIG_WELLD_ADAPTIVE_SLEEP_ENABLED=y
# CONFIG_WELLD_SLEEP_MIN_SEC=60
# CONFIG_WELLD_SLEEP_MAX_SEC=1800

# ---------- Diagnostics ----------
# Print the RTC event log on every wakeup (up to 17 extra log lines).
# Useful for field diagnosis; leave off in production to keep logs minimal.
# CONFIG_WELLD_RTC_LOG_PRINT_ENABLED=y
```

## test/sensor/sdkconfig.defaults
```kconfig
CONFIG_WELLD_SENSOR_ADC_CHANNEL=0
CONFIG_WELLD_SENSOR_SHUNT_MILLIOHMS=100000
CONFIG_WELLD_SENSOR_MAX_DEPTH_CM=600
CONFIG_WELLD_DS18B20_GPIO=4
CONFIG_WELLD_BATT_DIVIDER_RATIO=430
```
